## Kconfig
```kconfig
config ZMK_BEHAVIOR_WHEEL_TICK
    bool
    default y
    depends on DT_HAS_ZMK_BEHAVIOR_WHEEL_TICK_ENABLED
```

## dts/bindings/behaviors/zmk,behavior-wheel-tick.yaml
```yaml
description: Sends a single mouse wheel step per press (for encoders)

compatible: "zmk,behavior-wheel-tick"

include: one_param.yaml
```
